## twister-out/qemu_x86_atom/zephyr_gnu/zephyr-course/tests/ring_buf/homework.unit.ring_buf/Kconfig/soc/Kconfig
```kconfig
# Load Zephyr SoC Kconfig descriptions.
osource "C:/zephyrtwister/deps/zephyr/soc/xlnx/zynqmp/Kconfig"
osource "C:/zephyrtwister/deps/zephyr/soc/xlnx/zynq7000/Kconfig"
osource "C:/zephyrtwister/deps/zephyr/soc/xlnx/versalnet/Kconfig"
osource "C:/zephyrtwister/deps/zephyr/soc/xlnx/versal2/Kconfig"
osource "C:/zephyrtwister/deps/zephyr/soc/xlnx/versal/Kconfig"
osource "C:/zephyrtwister/deps/zephyr/soc/xen/Kconfig"
osource "C:/zephyrtwister/deps/zephyr/soc/wch/ch32v/Kconfig"
osource "C:/zephyrtwister/deps/zephyr/soc/ti/simplelink/Kconfig"
osource "C:/zephyrtwister/deps/zephyr/soc/ti/mspm0/Kconfig"
osource "C:/zephyrtwister/deps/zephyr/soc/ti/lm3s6965/Kconfig"
osource "C:/zephyrtwister/deps/zephyr/soc/ti/k3/Kconfig"
osource "C:/zephyrtwister/deps/zephyr/soc/telink/tlsr/Kconfig"
osource "C:/zephyrtwister/deps/zephyr/soc/syna/sr100/Kconfig"
osource "C:/zephyrtwister/deps/zephyr/soc/starfive/jh71xx/Kconfig"
osource "C:/zephyrtwister/deps/zephyr/soc/st/stm32/Kconfig"
osource "C:/zephyrtwister/deps/zephyr/soc/snps/qemu_arc/Kconfig"
osource "C:/zephyrtwister/deps/zephyr/soc/snps/nsim/arc_v/Kconfig"
osource "C:/zephyrtwister/deps/zephyr/soc/snps/nsim/arc_classic/Kconfig"
osource "C:/zephyrtwister/deps/zephyr/soc/snps/hsdk4xd/Kconfig"
osource "C:/zephyrtwister/deps/zephyr/soc/snps/hsdk/Kconfig"
osource "C:/zephyrtwister/deps/zephyr/soc/snps/emsk/Kconfig"
osource "C:/zephyrtwister/deps/zephyr/soc/snps/emsdp/Kconfig"
osource "C:/zephyrtwister/deps/zephyr/soc/snps/arc_iot/Kconfig"
osource "C:/zephyrtwister/deps/zephyr/soc/silabs/Kconfig"
osource "C:/zephyrtwister/deps/zephyr/soc/sifli/sf32/Kconfig"
osource "C:/zephyrtwister/deps/zephyr/soc/sifive/sifive_freedom/Kconfig"
osource "C:/zephyrtwister/deps/zephyr/soc/sensry/Kconfig"
osource "C:/zephyrtwister/deps/zephyr/soc/rockchip/Kconfig"
osource "C:/zephyrtwister/deps/zephyr/soc/renode/riscv_virtual/Kconfig"
osource "C:/zephyrtwister/deps/zephyr/soc/renode/cortex_r8_virtual/Kconfig"
osource "C:/zephyrtwister/deps/zephyr/soc/renesas/smartbond/Kconfig"
osource "C:/zephyrtwister/deps/zephyr/soc/renesas/rz/Kconfig"
osource "C:/zephyrtwister/deps/zephyr/soc/renesas/rx/Kconfig"
osource "C:/zephyrtwister/deps/zephyr/soc/renesas/rcar/Kconfig"
osource "C:/zephyrtwister/deps/zephyr/soc/renesas/ra/Kconfig"
osource "C:/zephyrtwister/deps/zephyr/soc/realtek/fingerprint/Kconfig"
osource "C:/zephyrtwister/deps/zephyr/soc/realtek/ec/Kconfig"
osource "C:/zephyrtwister/deps/zephyr/soc/realtek/bee/Kconfig"
osource "C:/zephyrtwister/deps/zephyr/soc/realtek/ameba/Kconfig"
osource "C:/zephyrtwister/deps/zephyr/soc/raspberrypi/rpi_pico/Kconfig"
osource "C:/zephyrtwister/deps/zephyr/soc/quicklogic/eos_s3/Kconfig"
osource "C:/zephyrtwister/deps/zephyr/soc/qemu/virt_riscv/Kconfig"
osource "C:/zephyrtwister/deps/zephyr/soc/qemu/or1k/Kconfig"
osource "C:/zephyrtwister/deps/zephyr/soc/qemu/malta/Kconfig"
osource "C:/zephyrtwister/deps/zephyr/soc/openisa/rv32m1/Kconfig"
osource "C:/zephyrtwister/deps/zephyr/soc/openhwgroup/cva6/Kconfig"
osource "C:/zephyrtwister/deps/zephyr/soc/oct/osd32mp15x/Kconfig"
osource "C:/zephyrtwister/deps/zephyr/soc/nxp/s32/Kconfig"
osource "C:/zephyrtwister/deps/zephyr/soc/nxp/rw/Kconfig"
osource "C:/zephyrtwister/deps/zephyr/soc/nxp/mcx/Kconfig"
osource "C:/zephyrtwister/deps/zephyr/soc/nxp/lpc/Kconfig"
osource "C:/zephyrtwister/deps/zephyr/soc/nxp/layerscape/Kconfig"
osource "C:/zephyrtwister/deps/zephyr/soc/nxp/kinetis/Kconfig"
osource "C:/zephyrtwister/deps/zephyr/soc/nxp/imxrt/Kconfig"
osource "C:/zephyrtwister/deps/zephyr/soc/nxp/imx/Kconfig"
osource "C:/zephyrtwister/deps/zephyr/soc/nuvoton/numicro/Kconfig"
osource "C:/zephyrtwister/deps/zephyr/soc/nuvoton/numaker/Kconfig"
osource "C:/zephyrtwister/deps/zephyr/soc/nuvoton/npcx/Kconfig"
osource "C:/zephyrtwister/deps/zephyr/soc/nuvoton/npcm/Kconfig"
osource "C:/zephyrtwister/deps/zephyr/soc/nordic/Kconfig"
osource "C:/zephyrtwister/deps/zephyr/soc/neorv32/Kconfig"
osource "C:/zephyrtwister/deps/zephyr/soc/native/inf_clock/Kconfig"
osource "C:/zephyrtwister/deps/zephyr/soc/microchip/sam/sama7/Kconfig"
osource "C:/zephyrtwister/deps/zephyr/soc/microchip/sam/sam_d5x_e5x/Kconfig"
osource "C:/zephyrtwister/deps/zephyr/soc/microchip/pic64/Kconfig"
osource "C:/zephyrtwister/deps/zephyr/soc/microchip/pic32c/pic32cz_ca/Kconfig"
osource "C:/zephyrtwister/deps/zephyr/soc/microchip/pic32c/pic32cx_sg/Kconfig"
osource "C:/zephyrtwister/deps/zephyr/soc/microchip/pic32c/pic32cm_sg_gc/Kconfig"
osource "C:/zephyrtwister/deps/zephyr/soc/microchip/pic32c/pic32cm_pl/Kconfig"
osource "C:/zephyrtwister/deps/zephyr/soc/microchip/pic32c/pic32cm_jh/Kconfig"
osource "C:/zephyrtwister/deps/zephyr/soc/microchip/pic32c/pic32ck_sg_gc/Kconfig"
osource "C:/zephyrtwister/deps/zephyr/soc/microchip/miv/Kconfig"
osource "C:/zephyrtwister/deps/zephyr/soc/microchip/mec/Kconfig"
osource "C:/zephyrtwister/deps/zephyr/soc/mediatek/mt8xxx/Kconfig"
osource "C:/zephyrtwister/deps/zephyr/soc/lowrisc/opentitan/Kconfig"
osource "C:/zephyrtwister/deps/zephyr/soc/litex/Kconfig"
osource "C:/zephyrtwister/deps/zephyr/soc/ite/ec/Kconfig"
osource "C:/zephyrtwister/deps/zephyr/soc/intel/wildcat_lake/Kconfig"
osource "C:/zephyrtwister/deps/zephyr/soc/intel/raptor_lake/Kconfig"
osource "C:/zephyrtwister/deps/zephyr/soc/intel/panther_lake/Kconfig"
osource "C:/zephyrtwister/deps/zephyr/soc/intel/lakemont/Kconfig"
osource "C:/zephyrtwister/deps/zephyr/soc/intel/intel_socfpga_std/Kconfig"
osource "C:/zephyrtwister/deps/zephyr/soc/intel/intel_socfpga/Kconfig"
osource "C:/zephyrtwister/deps/zephyr/soc/intel/intel_niosv/Kconfig"
osource "C:/zephyrtwister/deps/zephyr/soc/intel/intel_ish/Kconfig"
osource "C:/zephyrtwister/deps/zephyr/soc/intel/intel_adsp/Kconfig"
osource "C:/zephyrtwister/deps/zephyr/soc/intel/elkhart_lake/Kconfig"
osource "C:/zephyrtwister/deps/zephyr/soc/intel/atom/Kconfig"
osource "C:/zephyrtwister/deps/zephyr/soc/intel/apollo_lake/Kconfig"
osource "C:/zephyrtwister/deps/zephyr/soc/intel/alder_lake/Kconfig"
osource "C:/zephyrtwister/deps/zephyr/soc/infineon/psoc4/Kconfig"
osource "C:/zephyrtwister/deps/zephyr/soc/infineon/edge/Kconfig"
osource "C:/zephyrtwister/deps/zephyr/soc/infineon/cat3/Kconfig"
osource "C:/zephyrtwister/deps/zephyr/soc/infineon/cat1c/Kconfig"
osource "C:/zephyrtwister/deps/zephyr/soc/infineon/cat1b/Kconfig"
osource "C:/zephyrtwister/deps/zephyr/soc/infineon/cat1a/Kconfig"
osource "C:/zephyrtwister/deps/zephyr/soc/gd/gd32/Kconfig"
osource "C:/zephyrtwister/deps/zephyr/soc/gaisler/leon3/Kconfig"
osource "C:/zephyrtwister/deps/zephyr/soc/gaisler/gr716a/Kconfig"
osource "C:/zephyrtwister/deps/zephyr/soc/focaltech/Kconfig"
osource "C:/zephyrtwister/deps/zephyr/soc/espressif/Kconfig"
osource "C:/zephyrtwister/deps/zephyr/soc/ene/kb1200/Kconfig"
osource "C:/zephyrtwister/deps/zephyr/soc/ene/kb106x/Kconfig"
osource "C:/zephyrtwister/deps/zephyr/soc/elan/em32f967/Kconfig"
osource "C:/zephyrtwister/deps/zephyr/soc/egis/Kconfig"
osource "C:/zephyrtwister/deps/zephyr/soc/efinix/sapphire/Kconfig"
osource "C:/zephyrtwister/deps/zephyr/soc/cdns/xtensa_sample_controller/Kconfig"
osource "C:/zephyrtwister/deps/zephyr/soc/cdns/swerv/Kconfig"
osource "C:/zephyrtwister/deps/zephyr/soc/cdns/sample_controller32/Kconfig"
osource "C:/zephyrtwister/deps/zephyr/soc/cdns/dc233c/Kconfig"
osource "C:/zephyrtwister/deps/zephyr/soc/brcm/bcmvk/Kconfig"
osource "C:/zephyrtwister/deps/zephyr/soc/brcm/bcm2712/Kconfig"
osource "C:/zephyrtwister/deps/zephyr/soc/brcm/bcm2711/Kconfig"
osource "C:/zephyrtwister/deps/zephyr/soc/blackberry/qnxhv_vm/Kconfig"
osource "C:/zephyrtwister/deps/zephyr/soc/bflb/Kconfig"
osource "C:/zephyrtwister/deps/zephyr/soc/atmel/sam0/Kconfig"
osource "C:/zephyrtwister/deps/zephyr/soc/atmel/sam/Kconfig"
osource "C:/zephyrtwister/deps/zephyr/soc/aspeed/Kconfig"
osource "C:/zephyrtwister/deps/zephyr/soc/arm/Kconfig"
osource "C:/zephyrtwister/deps/zephyr/soc/arm/beetle/Kconfig"
osource "C:/zephyrtwister/deps/zephyr/soc/antmicro/myra/Kconfig"
osource "C:/zephyrtwister/deps/zephyr/soc/andestech/Kconfig"
osource "C:/zephyrtwister/deps/zephyr/soc/amd/acp_7_0/Kconfig"
osource "C:/zephyrtwister/deps/zephyr/soc/amd/acp_6_0/Kconfig"
osource "C:/zephyrtwister/deps/zephyr/soc/ambiq/Kconfig"
osource "C:/zephyrtwister/deps/zephyr/soc/allwinner/sun8i_h3/Kconfig"
osource "C:/zephyrtwister/deps/zephyr/soc/allwinner/sun50i_h618/Kconfig"
osource "C:/zephyrtwister/deps/zephyr/soc/alif/ensemble/Kconfig"
osource "C:/zephyrtwister/deps/zephyr/soc/alif/balletto/Kconfig"
osource "C:/zephyrtwister/deps/zephyr/soc/aesc/Kconfig"
osource "C:/zephyrtwister/deps/zephyr/soc/adi/max32/Kconfig"
```

## west.yml
```yaml
manifest:
  version: 1.0

  projects:
    - name: zephyr
      url: https://github.com/zephyrproject-rtos/zephyr
      revision: ad056d5454d57002c2b330b301d1e9906dd5fd0f
      import:
        name-allowlist:
          - cmsis_6
          # - hal_nxp
          - hal_stm32
          # - hal_nordic
        path-prefix: deps
```
