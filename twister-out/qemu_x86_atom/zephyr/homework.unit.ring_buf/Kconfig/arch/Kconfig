## twister-out/qemu_x86_atom/zephyr/homework.unit.ring_buf/Kconfig/soc/Kconfig.sysbuild
```kconfig
# Load Sysbuild SoC Kconfig descriptions.
osource "F:/Embedded_learning/Zephyr/ZephyrWrkSpace/deps/zephyr/soc/xlnx/zynqmp/Kconfig.sysbuild"
osource "F:/Embedded_learning/Zephyr/ZephyrWrkSpace/deps/zephyr/soc/xlnx/zynq7000/Kconfig.sysbuild"
osource "F:/Embedded_learning/Zephyr/ZephyrWrkSpace/deps/zephyr/soc/xlnx/versalnet/Kconfig.sysbuild"
osource "F:/Embedded_learning/Zephyr/ZephyrWrkSpace/deps/zephyr/soc/xlnx/versal2/Kconfig.sysbuild"
osource "F:/Embedded_learning/Zephyr/ZephyrWrkSpace/deps/zephyr/soc/xen/Kconfig.sysbuild"
osource "F:/Embedded_learning/Zephyr/ZephyrWrkSpace/deps/zephyr/soc/wch/ch32v/Kconfig.sysbuild"
osource "F:/Embedded_learning/Zephyr/ZephyrWrkSpace/deps/zephyr/soc/ti/simplelink/Kconfig.sysbuild"
osource "F:/Embedded_learning/Zephyr/ZephyrWrkSpace/deps/zephyr/soc/ti/mspm0/Kconfig.sysbuild"
osource "F:/Embedded_learning/Zephyr/ZephyrWrkSpace/deps/zephyr/soc/ti/lm3s6965/Kconfig.sysbuild"
osource "F:/Embedded_learning/Zephyr/ZephyrWrkSpace/deps/zephyr/soc/ti/k3/Kconfig.sysbuild"
osource "F:/Embedded_learning/Zephyr/ZephyrWrkSpace/deps/zephyr/soc/telink/tlsr/Kconfig.sysbuild"
osource "F:/Embedded_learning/Zephyr/ZephyrWrkSpace/deps/zephyr/soc/starfive/jh71xx/Kconfig.sysbuild"
osource "F:/Embedded_learning/Zephyr/ZephyrWrkSpace/deps/zephyr/soc/st/stm32/Kconfig.sysbuild"
osource "F:/Embedded_learning/Zephyr/ZephyrWrkSpace/deps/zephyr/soc/snps/qemu_arc/Kconfig.sysbuild"
osource "F:/Embedded_learning/Zephyr/ZephyrWrkSpace/deps/zephyr/soc/snps/nsim/arc_v/Kconfig.sysbuild"
osource "F:/Embedded_learning/Zephyr/ZephyrWrkSpace/deps/zephyr/soc/snps/nsim/arc_classic/Kconfig.sysbuild"
osource "F:/Embedded_learning/Zephyr/ZephyrWrkSpace/deps/zephyr/soc/snps/hsdk4xd/Kconfig.sysbuild"
osource "F:/Embedded_learning/Zephyr/ZephyrWrkSpace/deps/zephyr/soc/snps/hsdk/Kconfig.sysbuild"
osource "F:/Embedded_learning/Zephyr/ZephyrWrkSpace/deps/zephyr/soc/snps/emsk/Kconfig.sysbuild"
osource "F:/Embedded_learning/Zephyr/ZephyrWrkSpace/deps/zephyr/soc/snps/emsdp/Kconfig.sysbuild"
osource "F:/Embedded_learning/Zephyr/ZephyrWrkSpace/deps/zephyr/soc/snps/arc_iot/Kconfig.sysbuild"
osource "F:/Embedded_learning/Zephyr/ZephyrWrkSpace/deps/zephyr/soc/silabs/Kconfig.sysbuild"
osource "F:/Embedded_learning/Zephyr/ZephyrWrkSpace/deps/zephyr/soc/sifive/sifive_freedom/Kconfig.sysbuild"
osource "F:/Embedded_learning/Zephyr/ZephyrWrkSpace/deps/zephyr/soc/sensry/Kconfig.sysbuild"
osource "F:/Embedded_learning/Zephyr/ZephyrWrkSpace/deps/zephyr/soc/rockchip/Kconfig.sysbuild"
osource "F:/Embedded_learning/Zephyr/ZephyrWrkSpace/deps/zephyr/soc/renode/riscv_virtual/Kconfig.sysbuild"
osource "F:/Embedded_learning/Zephyr/ZephyrWrkSpace/deps/zephyr/soc/renode/cortex_r8_virtual/Kconfig.sysbuild"
osource "F:/Embedded_learning/Zephyr/ZephyrWrkSpace/deps/zephyr/soc/renesas/smartbond/Kconfig.sysbuild"
osource "F:/Embedded_learning/Zephyr/ZephyrWrkSpace/deps/zephyr/soc/renesas/rz/Kconfig.sysbuild"
osource "F:/Embedded_learning/Zephyr/ZephyrWrkSpace/deps/zephyr/soc/renesas/rx/Kconfig.sysbuild"
osource "F:/Embedded_learning/Zephyr/ZephyrWrkSpace/deps/zephyr/soc/renesas/rcar/Kconfig.sysbuild"
osource "F:/Embedded_learning/Zephyr/ZephyrWrkSpace/deps/zephyr/soc/renesas/ra/Kconfig.sysbuild"
osource "F:/Embedded_learning/Zephyr/ZephyrWrkSpace/deps/zephyr/soc/realtek/ec/Kconfig.sysbuild"
osource "F:/Embedded_learning/Zephyr/ZephyrWrkSpace/deps/zephyr/soc/raspberrypi/rpi_pico/Kconfig.sysbuild"
osource "F:/Embedded_learning/Zephyr/ZephyrWrkSpace/deps/zephyr/soc/quicklogic/eos_s3/Kconfig.sysbuild"
osource "F:/Embedded_learning/Zephyr/ZephyrWrkSpace/deps/zephyr/soc/qemu/virt_riscv/Kconfig.sysbuild"
osource "F:/Embedded_learning/Zephyr/ZephyrWrkSpace/deps/zephyr/soc/qemu/malta/Kconfig.sysbuild"
osource "F:/Embedded_learning/Zephyr/ZephyrWrkSpace/deps/zephyr/soc/openisa/rv32m1/Kconfig.sysbuild"
osource "F:/Embedded_learning/Zephyr/ZephyrWrkSpace/deps/zephyr/soc/openhwgroup/cva6/Kconfig.sysbuild"
osource "F:/Embedded_learning/Zephyr/ZephyrWrkSpace/deps/zephyr/soc/oct/osd32mp15x/Kconfig.sysbuild"
osource "F:/Embedded_learning/Zephyr/ZephyrWrkSpace/deps/zephyr/soc/nxp/s32/Kconfig.sysbuild"
osource "F:/Embedded_learning/Zephyr/ZephyrWrkSpace/deps/zephyr/soc/nxp/rw/Kconfig.sysbuild"
osource "F:/Embedded_learning/Zephyr/ZephyrWrkSpace/deps/zephyr/soc/nxp/mcx/Kconfig.sysbuild"
osource "F:/Embedded_learning/Zephyr/ZephyrWrkSpace/deps/zephyr/soc/nxp/lpc/Kconfig.sysbuild"
osource "F:/Embedded_learning/Zephyr/ZephyrWrkSpace/deps/zephyr/soc/nxp/layerscape/Kconfig.sysbuild"
osource "F:/Embedded_learning/Zephyr/ZephyrWrkSpace/deps/zephyr/soc/nxp/kinetis/Kconfig.sysbuild"
osource "F:/Embedded_learning/Zephyr/ZephyrWrkSpace/deps/zephyr/soc/nxp/imxrt/Kconfig.sysbuild"
osource "F:/Embedded_learning/Zephyr/ZephyrWrkSpace/deps/zephyr/soc/nxp/imx/Kconfig.sysbuild"
osource "F:/Embedded_learning/Zephyr/ZephyrWrkSpace/deps/zephyr/soc/nuvoton/numicro/Kconfig.sysbuild"
osource "F:/Embedded_learning/Zephyr/ZephyrWrkSpace/deps/zephyr/soc/nuvoton/numaker/Kconfig.sysbuild"
osource "F:/Embedded_learning/Zephyr/ZephyrWrkSpace/deps/zephyr/soc/nuvoton/npcx/Kconfig.sysbuild"
osource "F:/Embedded_learning/Zephyr/ZephyrWrkSpace/deps/zephyr/soc/nuvoton/npcm/Kconfig.sysbuild"
osource "F:/Embedded_learning/Zephyr/ZephyrWrkSpace/deps/zephyr/soc/nordic/Kconfig.sysbuild"
osource "F:/Embedded_learning/Zephyr/ZephyrWrkSpace/deps/zephyr/soc/neorv32/Kconfig.sysbuild"
osource "F:/Embedded_learning/Zephyr/ZephyrWrkSpace/deps/zephyr/soc/native/inf_clock/Kconfig.sysbuild"
osource "F:/Embedded_learning/Zephyr/ZephyrWrkSpace/deps/zephyr/soc/microchip/sam/Kconfig.sysbuild"
osource "F:/Embedded_learning/Zephyr/ZephyrWrkSpace/deps/zephyr/soc/microchip/miv/Kconfig.sysbuild"
osource "F:/Embedded_learning/Zephyr/ZephyrWrkSpace/deps/zephyr/soc/microchip/mec/Kconfig.sysbuild"
osource "F:/Embedded_learning/Zephyr/ZephyrWrkSpace/deps/zephyr/soc/mediatek/mt8xxx/Kconfig.sysbuild"
osource "F:/Embedded_learning/Zephyr/ZephyrWrkSpace/deps/zephyr/soc/lowrisc/opentitan/Kconfig.sysbuild"
osource "F:/Embedded_learning/Zephyr/ZephyrWrkSpace/deps/zephyr/soc/litex/litex_vexriscv/Kconfig.sysbuild"
osource "F:/Embedded_learning/Zephyr/ZephyrWrkSpace/deps/zephyr/soc/ite/ec/Kconfig.sysbuild"
osource "F:/Embedded_learning/Zephyr/ZephyrWrkSpace/deps/zephyr/soc/intel/raptor_lake/Kconfig.sysbuild"
osource "F:/Embedded_learning/Zephyr/ZephyrWrkSpace/deps/zephyr/soc/intel/lakemont/Kconfig.sysbuild"
osource "F:/Embedded_learning/Zephyr/ZephyrWrkSpace/deps/zephyr/soc/intel/intel_socfpga_std/Kconfig.sysbuild"
osource "F:/Embedded_learning/Zephyr/ZephyrWrkSpace/deps/zephyr/soc/intel/intel_socfpga/Kconfig.sysbuild"
osource "F:/Embedded_learning/Zephyr/ZephyrWrkSpace/deps/zephyr/soc/intel/intel_niosv/Kconfig.sysbuild"
osource "F:/Embedded_learning/Zephyr/ZephyrWrkSpace/deps/zephyr/soc/intel/intel_ish/Kconfig.sysbuild"
osource "F:/Embedded_learning/Zephyr/ZephyrWrkSpace/deps/zephyr/soc/intel/intel_adsp/Kconfig.sysbuild"
osource "F:/Embedded_learning/Zephyr/ZephyrWrkSpace/deps/zephyr/soc/intel/elkhart_lake/Kconfig.sysbuild"
osource "F:/Embedded_learning/Zephyr/ZephyrWrkSpace/deps/zephyr/soc/intel/atom/Kconfig.sysbuild"
osource "F:/Embedded_learning/Zephyr/ZephyrWrkSpace/deps/zephyr/soc/intel/apollo_lake/Kconfig.sysbuild"
osource "F:/Embedded_learning/Zephyr/ZephyrWrkSpace/deps/zephyr/soc/intel/alder_lake/Kconfig.sysbuild"
osource "F:/Embedded_learning/Zephyr/ZephyrWrkSpace/deps/zephyr/soc/infineon/cat3/Kconfig.sysbuild"
osource "F:/Embedded_learning/Zephyr/ZephyrWrkSpace/deps/zephyr/soc/infineon/cat1c/Kconfig.sysbuild"
osource "F:/Embedded_learning/Zephyr/ZephyrWrkSpace/deps/zephyr/soc/infineon/cat1b/Kconfig.sysbuild"
osource "F:/Embedded_learning/Zephyr/ZephyrWrkSpace/deps/zephyr/soc/infineon/cat1a/Kconfig.sysbuild"
osource "F:/Embedded_learning/Zephyr/ZephyrWrkSpace/deps/zephyr/soc/gd/gd32/Kconfig.sysbuild"
osource "F:/Embedded_learning/Zephyr/ZephyrWrkSpace/deps/zephyr/soc/gaisler/leon3/Kconfig.sysbuild"
osource "F:/Embedded_learning/Zephyr/ZephyrWrkSpace/deps/zephyr/soc/gaisler/gr716a/Kconfig.sysbuild"
osource "F:/Embedded_learning/Zephyr/ZephyrWrkSpace/deps/zephyr/soc/espressif/Kconfig.sysbuild"
osource "F:/Embedded_learning/Zephyr/ZephyrWrkSpace/deps/zephyr/soc/ene/kb1200/Kconfig.sysbuild"
osource "F:/Embedded_learning/Zephyr/ZephyrWrkSpace/deps/zephyr/soc/ene/kb106x/Kconfig.sysbuild"
osource "F:/Embedded_learning/Zephyr/ZephyrWrkSpace/deps/zephyr/soc/efinix/sapphire/Kconfig.sysbuild"
osource "F:/Embedded_learning/Zephyr/ZephyrWrkSpace/deps/zephyr/soc/cdns/xtensa_sample_controller/Kconfig.sysbuild"
osource "F:/Embedded_learning/Zephyr/ZephyrWrkSpace/deps/zephyr/soc/cdns/sample_controller32/Kconfig.sysbuild"
osource "F:/Embedded_learning/Zephyr/ZephyrWrkSpace/deps/zephyr/soc/cdns/dc233c/Kconfig.sysbuild"
osource "F:/Embedded_learning/Zephyr/ZephyrWrkSpace/deps/zephyr/soc/brcm/bcmvk/Kconfig.sysbuild"
osource "F:/Embedded_learning/Zephyr/ZephyrWrkSpace/deps/zephyr/soc/brcm/bcm2712/Kconfig.sysbuild"
osource "F:/Embedded_learning/Zephyr/ZephyrWrkSpace/deps/zephyr/soc/brcm/bcm2711/Kconfig.sysbuild"
osource "F:/Embedded_learning/Zephyr/ZephyrWrkSpace/deps/zephyr/soc/bflb/Kconfig.sysbuild"
osource "F:/Embedded_learning/Zephyr/ZephyrWrkSpace/deps/zephyr/soc/atmel/sam0/Kconfig.sysbuild"
osource "F:/Embedded_learning/Zephyr/ZephyrWrkSpace/deps/zephyr/soc/atmel/sam/Kconfig.sysbuild"
osource "F:/Embedded_learning/Zephyr/ZephyrWrkSpace/deps/zephyr/soc/aspeed/Kconfig.sysbuild"
osource "F:/Embedded_learning/Zephyr/ZephyrWrkSpace/deps/zephyr/soc/arm/Kconfig.sysbuild"
osource "F:/Embedded_learning/Zephyr/ZephyrWrkSpace/deps/zephyr/soc/arm/beetle/Kconfig.sysbuild"
osource "F:/Embedded_learning/Zephyr/ZephyrWrkSpace/deps/zephyr/soc/antmicro/myra/Kconfig.sysbuild"
osource "F:/Embedded_learning/Zephyr/ZephyrWrkSpace/deps/zephyr/soc/andestech/Kconfig.sysbuild"
osource "F:/Embedded_learning/Zephyr/ZephyrWrkSpace/deps/zephyr/soc/amd/acp_6_0/Kconfig.sysbuild"
osource "F:/Embedded_learning/Zephyr/ZephyrWrkSpace/deps/zephyr/soc/ambiq/Kconfig.sysbuild"
osource "F:/Embedded_learning/Zephyr/ZephyrWrkSpace/deps/zephyr/soc/aesc/Kconfig.sysbuild"
osource "F:/Embedded_learning/Zephyr/ZephyrWrkSpace/deps/zephyr/soc/adi/max32/Kconfig.sysbuild"
```

## twister-out/qemu_x86_atom/zephyr_gnu/zephyr-course/tests/ring_buf/homework.unit.ring_buf/Kconfig/arch/Kconfig
```kconfig
# Load Zephyr Arch Kconfig descriptions.
osource "C:/zephyrtwister/deps/zephyr/arch/rx/Kconfig"
osource "C:/zephyrtwister/deps/zephyr/arch/x86/Kconfig"
osource "C:/zephyrtwister/deps/zephyr/arch/xtensa/Kconfig"
osource "C:/zephyrtwister/deps/zephyr/arch/sparc/Kconfig"
osource "C:/zephyrtwister/deps/zephyr/arch/riscv/Kconfig"
osource "C:/zephyrtwister/deps/zephyr/arch/posix/Kconfig"
osource "C:/zephyrtwister/deps/zephyr/arch/openrisc/Kconfig"
osource "C:/zephyrtwister/deps/zephyr/arch/mips/Kconfig"
osource "C:/zephyrtwister/deps/zephyr/arch/arm64/Kconfig"
osource "C:/zephyrtwister/deps/zephyr/arch/arm/Kconfig"
osource "C:/zephyrtwister/deps/zephyr/arch/arc/Kconfig"
```

## twister-out/qemu_x86_atom/zephyr_gnu/zephyr-course/tests/ring_buf/homework.unit.ring_buf/Kconfig/boards/Kconfig.defconfig
```kconfig
# Load Zephyr board defconfig descriptions.
osource "C:/zephyrtwister/deps/zephyr/boards/qemu/x86/Kconfig.defconfig"
```

## twister-out/qemu_x86_atom/zephyr_gnu/zephyr-course/tests/ring_buf/homework.unit.ring_buf/Kconfig/boards/Kconfig.qemu_x86
```kconfig
# Load board Kconfig descriptions.
osource "C:/zephyrtwister/deps/zephyr/boards/qemu/x86/Kconfig.qemu_x86"
```

## twister-out/qemu_x86_atom/zephyr_gnu/zephyr-course/tests/ring_buf/homework.unit.ring_buf/Kconfig/boards/Kconfig.sysbuild
```kconfig
# Load Sysbuild board Kconfig descriptions.
osource "C:/zephyrtwister/deps/zephyr/boards/qemu/x86/Kconfig.sysbuild"
```
