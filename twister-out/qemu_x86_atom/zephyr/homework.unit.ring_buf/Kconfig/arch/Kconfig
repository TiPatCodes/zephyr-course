## twister-out/qemu_x86_atom/zephyr/homework.unit.ring_buf/Kconfig/soc/Kconfig.soc
```kconfig
# Load SoC Kconfig descriptions.
osource "F:/Embedded_learning/Zephyr/ZephyrWrkSpace/deps/zephyr/soc/xlnx/zynqmp/Kconfig.soc"
osource "F:/Embedded_learning/Zephyr/ZephyrWrkSpace/deps/zephyr/soc/xlnx/zynq7000/Kconfig.soc"
osource "F:/Embedded_learning/Zephyr/ZephyrWrkSpace/deps/zephyr/soc/xlnx/versalnet/Kconfig.soc"
osource "F:/Embedded_learning/Zephyr/ZephyrWrkSpace/deps/zephyr/soc/xlnx/versal2/Kconfig.soc"
osource "F:/Embedded_learning/Zephyr/ZephyrWrkSpace/deps/zephyr/soc/xen/Kconfig.soc"
osource "F:/Embedded_learning/Zephyr/ZephyrWrkSpace/deps/zephyr/soc/wch/ch32v/Kconfig.soc"
osource "F:/Embedded_learning/Zephyr/ZephyrWrkSpace/deps/zephyr/soc/ti/simplelink/Kconfig.soc"
osource "F:/Embedded_learning/Zephyr/ZephyrWrkSpace/deps/zephyr/soc/ti/mspm0/Kconfig.soc"
osource "F:/Embedded_learning/Zephyr/ZephyrWrkSpace/deps/zephyr/soc/ti/lm3s6965/Kconfig.soc"
osource "F:/Embedded_learning/Zephyr/ZephyrWrkSpace/deps/zephyr/soc/ti/k3/Kconfig.soc"
osource "F:/Embedded_learning/Zephyr/ZephyrWrkSpace/deps/zephyr/soc/telink/tlsr/Kconfig.soc"
osource "F:/Embedded_learning/Zephyr/ZephyrWrkSpace/deps/zephyr/soc/starfive/jh71xx/Kconfig.soc"
osource "F:/Embedded_learning/Zephyr/ZephyrWrkSpace/deps/zephyr/soc/st/stm32/Kconfig.soc"
osource "F:/Embedded_learning/Zephyr/ZephyrWrkSpace/deps/zephyr/soc/snps/qemu_arc/Kconfig.soc"
osource "F:/Embedded_learning/Zephyr/ZephyrWrkSpace/deps/zephyr/soc/snps/nsim/arc_v/Kconfig.soc"
osource "F:/Embedded_learning/Zephyr/ZephyrWrkSpace/deps/zephyr/soc/snps/nsim/arc_classic/Kconfig.soc"
osource "F:/Embedded_learning/Zephyr/ZephyrWrkSpace/deps/zephyr/soc/snps/hsdk4xd/Kconfig.soc"
osource "F:/Embedded_learning/Zephyr/ZephyrWrkSpace/deps/zephyr/soc/snps/hsdk/Kconfig.soc"
osource "F:/Embedded_learning/Zephyr/ZephyrWrkSpace/deps/zephyr/soc/snps/emsk/Kconfig.soc"
osource "F:/Embedded_learning/Zephyr/ZephyrWrkSpace/deps/zephyr/soc/snps/emsdp/Kconfig.soc"
osource "F:/Embedded_learning/Zephyr/ZephyrWrkSpace/deps/zephyr/soc/snps/arc_iot/Kconfig.soc"
osource "F:/Embedded_learning/Zephyr/ZephyrWrkSpace/deps/zephyr/soc/silabs/Kconfig.soc"
osource "F:/Embedded_learning/Zephyr/ZephyrWrkSpace/deps/zephyr/soc/sifive/sifive_freedom/Kconfig.soc"
osource "F:/Embedded_learning/Zephyr/ZephyrWrkSpace/deps/zephyr/soc/sensry/Kconfig.soc"
osource "F:/Embedded_learning/Zephyr/ZephyrWrkSpace/deps/zephyr/soc/rockchip/Kconfig.soc"
osource "F:/Embedded_learning/Zephyr/ZephyrWrkSpace/deps/zephyr/soc/renode/riscv_virtual/Kconfig.soc"
osource "F:/Embedded_learning/Zephyr/ZephyrWrkSpace/deps/zephyr/soc/renode/cortex_r8_virtual/Kconfig.soc"
osource "F:/Embedded_learning/Zephyr/ZephyrWrkSpace/deps/zephyr/soc/renesas/smartbond/Kconfig.soc"
osource "F:/Embedded_learning/Zephyr/ZephyrWrkSpace/deps/zephyr/soc/renesas/rz/Kconfig.soc"
osource "F:/Embedded_learning/Zephyr/ZephyrWrkSpace/deps/zephyr/soc/renesas/rx/Kconfig.soc"
osource "F:/Embedded_learning/Zephyr/ZephyrWrkSpace/deps/zephyr/soc/renesas/rcar/Kconfig.soc"
osource "F:/Embedded_learning/Zephyr/ZephyrWrkSpace/deps/zephyr/soc/renesas/ra/Kconfig.soc"
osource "F:/Embedded_learning/Zephyr/ZephyrWrkSpace/deps/zephyr/soc/realtek/ec/Kconfig.soc"
osource "F:/Embedded_learning/Zephyr/ZephyrWrkSpace/deps/zephyr/soc/raspberrypi/rpi_pico/Kconfig.soc"
osource "F:/Embedded_learning/Zephyr/ZephyrWrkSpace/deps/zephyr/soc/quicklogic/eos_s3/Kconfig.soc"
osource "F:/Embedded_learning/Zephyr/ZephyrWrkSpace/deps/zephyr/soc/qemu/virt_riscv/Kconfig.soc"
osource "F:/Embedded_learning/Zephyr/ZephyrWrkSpace/deps/zephyr/soc/qemu/malta/Kconfig.soc"
osource "F:/Embedded_learning/Zephyr/ZephyrWrkSpace/deps/zephyr/soc/openisa/rv32m1/Kconfig.soc"
osource "F:/Embedded_learning/Zephyr/ZephyrWrkSpace/deps/zephyr/soc/openhwgroup/cva6/Kconfig.soc"
osource "F:/Embedded_learning/Zephyr/ZephyrWrkSpace/deps/zephyr/soc/oct/osd32mp15x/Kconfig.soc"
osource "F:/Embedded_learning/Zephyr/ZephyrWrkSpace/deps/zephyr/soc/nxp/s32/Kconfig.soc"
osource "F:/Embedded_learning/Zephyr/ZephyrWrkSpace/deps/zephyr/soc/nxp/rw/Kconfig.soc"
osource "F:/Embedded_learning/Zephyr/ZephyrWrkSpace/deps/zephyr/soc/nxp/mcx/Kconfig.soc"
osource "F:/Embedded_learning/Zephyr/ZephyrWrkSpace/deps/zephyr/soc/nxp/lpc/Kconfig.soc"
osource "F:/Embedded_learning/Zephyr/ZephyrWrkSpace/deps/zephyr/soc/nxp/layerscape/Kconfig.soc"
osource "F:/Embedded_learning/Zephyr/ZephyrWrkSpace/deps/zephyr/soc/nxp/kinetis/Kconfig.soc"
osource "F:/Embedded_learning/Zephyr/ZephyrWrkSpace/deps/zephyr/soc/nxp/imxrt/Kconfig.soc"
osource "F:/Embedded_learning/Zephyr/ZephyrWrkSpace/deps/zephyr/soc/nxp/imx/Kconfig.soc"
osource "F:/Embedded_learning/Zephyr/ZephyrWrkSpace/deps/zephyr/soc/nuvoton/numicro/Kconfig.soc"
osource "F:/Embedded_learning/Zephyr/ZephyrWrkSpace/deps/zephyr/soc/nuvoton/numaker/Kconfig.soc"
osource "F:/Embedded_learning/Zephyr/ZephyrWrkSpace/deps/zephyr/soc/nuvoton/npcx/Kconfig.soc"
osource "F:/Embedded_learning/Zephyr/ZephyrWrkSpace/deps/zephyr/soc/nuvoton/npcm/Kconfig.soc"
osource "F:/Embedded_learning/Zephyr/ZephyrWrkSpace/deps/zephyr/soc/nordic/Kconfig.soc"
osource "F:/Embedded_learning/Zephyr/ZephyrWrkSpace/deps/zephyr/soc/neorv32/Kconfig.soc"
osource "F:/Embedded_learning/Zephyr/ZephyrWrkSpace/deps/zephyr/soc/native/inf_clock/Kconfig.soc"
osource "F:/Embedded_learning/Zephyr/ZephyrWrkSpace/deps/zephyr/soc/microchip/sam/Kconfig.soc"
osource "F:/Embedded_learning/Zephyr/ZephyrWrkSpace/deps/zephyr/soc/microchip/miv/Kconfig.soc"
osource "F:/Embedded_learning/Zephyr/ZephyrWrkSpace/deps/zephyr/soc/microchip/mec/Kconfig.soc"
osource "F:/Embedded_learning/Zephyr/ZephyrWrkSpace/deps/zephyr/soc/mediatek/mt8xxx/Kconfig.soc"
osource "F:/Embedded_learning/Zephyr/ZephyrWrkSpace/deps/zephyr/soc/lowrisc/opentitan/Kconfig.soc"
osource "F:/Embedded_learning/Zephyr/ZephyrWrkSpace/deps/zephyr/soc/litex/litex_vexriscv/Kconfig.soc"
osource "F:/Embedded_learning/Zephyr/ZephyrWrkSpace/deps/zephyr/soc/ite/ec/Kconfig.soc"
osource "F:/Embedded_learning/Zephyr/ZephyrWrkSpace/deps/zephyr/soc/intel/raptor_lake/Kconfig.soc"
osource "F:/Embedded_learning/Zephyr/ZephyrWrkSpace/deps/zephyr/soc/intel/lakemont/Kconfig.soc"
osource "F:/Embedded_learning/Zephyr/ZephyrWrkSpace/deps/zephyr/soc/intel/intel_socfpga_std/Kconfig.soc"
osource "F:/Embedded_learning/Zephyr/ZephyrWrkSpace/deps/zephyr/soc/intel/intel_socfpga/Kconfig.soc"
osource "F:/Embedded_learning/Zephyr/ZephyrWrkSpace/deps/zephyr/soc/intel/intel_niosv/Kconfig.soc"
osource "F:/Embedded_learning/Zephyr/ZephyrWrkSpace/deps/zephyr/soc/intel/intel_ish/Kconfig.soc"
osource "F:/Embedded_learning/Zephyr/ZephyrWrkSpace/deps/zephyr/soc/intel/intel_adsp/Kconfig.soc"
osource "F:/Embedded_learning/Zephyr/ZephyrWrkSpace/deps/zephyr/soc/intel/elkhart_lake/Kconfig.soc"
osource "F:/Embedded_learning/Zephyr/ZephyrWrkSpace/deps/zephyr/soc/intel/atom/Kconfig.soc"
osource "F:/Embedded_learning/Zephyr/ZephyrWrkSpace/deps/zephyr/soc/intel/apollo_lake/Kconfig.soc"
osource "F:/Embedded_learning/Zephyr/ZephyrWrkSpace/deps/zephyr/soc/intel/alder_lake/Kconfig.soc"
osource "F:/Embedded_learning/Zephyr/ZephyrWrkSpace/deps/zephyr/soc/infineon/cat3/Kconfig.soc"
osource "F:/Embedded_learning/Zephyr/ZephyrWrkSpace/deps/zephyr/soc/infineon/cat1c/Kconfig.soc"
osource "F:/Embedded_learning/Zephyr/ZephyrWrkSpace/deps/zephyr/soc/infineon/cat1b/Kconfig.soc"
osource "F:/Embedded_learning/Zephyr/ZephyrWrkSpace/deps/zephyr/soc/infineon/cat1a/Kconfig.soc"
osource "F:/Embedded_learning/Zephyr/ZephyrWrkSpace/deps/zephyr/soc/gd/gd32/Kconfig.soc"
osource "F:/Embedded_learning/Zephyr/ZephyrWrkSpace/deps/zephyr/soc/gaisler/leon3/Kconfig.soc"
osource "F:/Embedded_learning/Zephyr/ZephyrWrkSpace/deps/zephyr/soc/gaisler/gr716a/Kconfig.soc"
osource "F:/Embedded_learning/Zephyr/ZephyrWrkSpace/deps/zephyr/soc/espressif/Kconfig.soc"
osource "F:/Embedded_learning/Zephyr/ZephyrWrkSpace/deps/zephyr/soc/ene/kb1200/Kconfig.soc"
osource "F:/Embedded_learning/Zephyr/ZephyrWrkSpace/deps/zephyr/soc/ene/kb106x/Kconfig.soc"
osource "F:/Embedded_learning/Zephyr/ZephyrWrkSpace/deps/zephyr/soc/efinix/sapphire/Kconfig.soc"
osource "F:/Embedded_learning/Zephyr/ZephyrWrkSpace/deps/zephyr/soc/cdns/xtensa_sample_controller/Kconfig.soc"
osource "F:/Embedded_learning/Zephyr/ZephyrWrkSpace/deps/zephyr/soc/cdns/sample_controller32/Kconfig.soc"
osource "F:/Embedded_learning/Zephyr/ZephyrWrkSpace/deps/zephyr/soc/cdns/dc233c/Kconfig.soc"
osource "F:/Embedded_learning/Zephyr/ZephyrWrkSpace/deps/zephyr/soc/brcm/bcmvk/Kconfig.soc"
osource "F:/Embedded_learning/Zephyr/ZephyrWrkSpace/deps/zephyr/soc/brcm/bcm2712/Kconfig.soc"
osource "F:/Embedded_learning/Zephyr/ZephyrWrkSpace/deps/zephyr/soc/brcm/bcm2711/Kconfig.soc"
osource "F:/Embedded_learning/Zephyr/ZephyrWrkSpace/deps/zephyr/soc/bflb/Kconfig.soc"
osource "F:/Embedded_learning/Zephyr/ZephyrWrkSpace/deps/zephyr/soc/atmel/sam0/Kconfig.soc"
osource "F:/Embedded_learning/Zephyr/ZephyrWrkSpace/deps/zephyr/soc/atmel/sam/Kconfig.soc"
osource "F:/Embedded_learning/Zephyr/ZephyrWrkSpace/deps/zephyr/soc/aspeed/Kconfig.soc"
osource "F:/Embedded_learning/Zephyr/ZephyrWrkSpace/deps/zephyr/soc/arm/Kconfig.soc"
osource "F:/Embedded_learning/Zephyr/ZephyrWrkSpace/deps/zephyr/soc/arm/beetle/Kconfig.soc"
osource "F:/Embedded_learning/Zephyr/ZephyrWrkSpace/deps/zephyr/soc/antmicro/myra/Kconfig.soc"
osource "F:/Embedded_learning/Zephyr/ZephyrWrkSpace/deps/zephyr/soc/andestech/Kconfig.soc"
osource "F:/Embedded_learning/Zephyr/ZephyrWrkSpace/deps/zephyr/soc/amd/acp_6_0/Kconfig.soc"
osource "F:/Embedded_learning/Zephyr/ZephyrWrkSpace/deps/zephyr/soc/ambiq/Kconfig.soc"
osource "F:/Embedded_learning/Zephyr/ZephyrWrkSpace/deps/zephyr/soc/aesc/Kconfig.soc"
osource "F:/Embedded_learning/Zephyr/ZephyrWrkSpace/deps/zephyr/soc/adi/max32/Kconfig.soc"
```
