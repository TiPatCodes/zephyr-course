## app/boards/copy_board/board.yml
```yaml
board:
  name: copy_board
  full_name: Copy_board
  vendor: Tirth
  socs:
    - name: stm32f407xx
```

## hello_world/boards/scratch_board/board.yml
```yaml
board:
  name: scratch_board
  full_name: Made from scratch_board
  vendor: Tirth
  socs:
    - name: stm32f407xx
```
